## firmware/hub/main/Kconfig.projbuild
```kconfig
menu "OmniSensor Configuration"

    config OMNI_BATTERY_PRESENT
        bool "A LiPo cell and the battery divider are fitted"
        default n
        help
            Enable once the 2x100k divider and a LiPo cell are actually wired to
            GPIO0. With this off the firmware skips battery sampling entirely and
            reports mains/USB power, rather than publishing whatever noise an
            unconnected ADC pin happens to read. See docs/HARDWARE_DESIGN.md §3.

endmenu
```
